## tests/subsys/fpga_bridges/boards/intel_socfpga_agilex5_socdk.conf
```kconfig
# Copyright (c) 2022-2023, Intel Corporation.
# SPDX-License-Identifier: Apache-2.0

# FPGA Bridge
CONFIG_FPGA_BRIDGE_INTEL=y

# Misc
CONFIG_HEAP_MEM_POOL_SIZE=16384

#SiP SVC Service
CONFIG_ARM_SIP_SVC_DRIVER=y
CONFIG_ARM_SIP_SVC_SUBSYS=y
CONFIG_ARM_SIP_SVC_SUBSYS_SINGLY_OPEN=y
```
